## meta-chronos-bsp/conf/layer.conf
```bitbake
# We have a conf and classes directory, add to BBPATH
BBPATH .= ":${LAYERDIR}"

# We have recipes-* directories, add to BBFILES
BBFILES += "${LAYERDIR}/recipes-*/*/*.bb \
            ${LAYERDIR}/recipes-*/*/*.bbappend"

BBFILE_COLLECTIONS += "meta-chronos-bsp"
BBFILE_PATTERN_meta-chronos-bsp = "^${LAYERDIR}/"
BBFILE_PRIORITY_meta-chronos-bsp = "6"

LAYERSERIES_COMPAT_meta-chronos-bsp = "scarthgap"
```

## meta-chronos-bsp/conf/machine/daytona.conf
```bitbake
#@TYPE: Machine
#@NAME: daytona
#@DESCRIPTION: Machine configuration for the daytona device

require conf/machine/include/x86/tune-corei7.inc
require conf/machine/include/x86/x86-base.inc
require conf/machine/include/rolex.inc
require conf/multilib.conf

# enable multilib
MULTILIBS = "multilib:lib32 multilib:libx32"
DEFAULTTUNE:virtclass-multilib-lib32 = "corei7-32"
DEFAULTTUNE:virtclass-multilib-libx32 = "corei7-64-x32"

# kernel default config
KBUILD_DEFCONFIG = "x86_64_defconfig"
```

## meta-chronos-bsp/conf/machine/include/cartier.inc
```bitbake
#
# Common configuration for the cartier product family devices
#

require conf/machine/include/chronos.inc

# console
SERIAL_CONSOLES = "115200;ttyAMA0"

# kernel default preferred provider
PREFERRED_PROVIDER_virtual/kernel = "linux-yocto-rt"
```

## meta-chronos-bsp/conf/machine/include/chronos.inc
```bitbake
#
# Common configuration for all devices
#

require conf/machine/include/qemuboot-chronos.inc

# override the linux standard base config
MACHINEOVERRIDES =. "linuxstdbase:"
```

## meta-chronos-bsp/conf/machine/include/qemuboot-chronos.inc
```bitbake
IMAGE_CLASSES += "qemuboot"

QB_SYSTEM_NAME:daytona = "qemu-system-x86_64"
QB_CPU:daytona = "-cpu max"
QB_NETWORK_DEVICE:daytona = "-device pci-bridge,chassis_nr=1,id=pci.1"
QB_NETWORK_DEVICE:daytona:append = " -device virtio-net-pci,netdev=net0,bus=pci.1,addr=0x01,mac=@MAC@"
QB_CMDLINE_IP_TAP:daytona = "ip=192.168.7.@CLIENT@::192.168.7.@GATEWAY@:255.255.255.0::enp1s1:off:8.8.8.8"

QB_SYSTEM_NAME:tank = "qemu-system-aarch64"
QB_MACHINE:tank = "-machine virt"
QB_CPU:tank = "-cpu max"
QB_NETWORK_DEVICE:tank = "-device pci-bridge,chassis_nr=1,id=pci.1"
QB_NETWORK_DEVICE:tank:append = " -device virtio-net-pci,netdev=net0,bus=pci.1,addr=0x01,mac=@MAC@"
QB_CMDLINE_IP_TAP:tank = "ip=192.168.7.@CLIENT@::192.168.7.@GATEWAY@:255.255.255.0::enp1s1:off:8.8.8.8"

QB_MEM = "-m 2048"
QB_OPT_APPEND = "-rtc base=utc,clock=host"
```

## meta-chronos-bsp/conf/machine/include/rolex.inc
```bitbake
#
# Common configuration for the rolex product family devices
#

require conf/machine/include/chronos.inc

# console
SERIAL_CONSOLES = "115200;ttyS0"

# kernel default preferred provider
PREFERRED_PROVIDER_virtual/kernel = "linux-yocto-rt"
```

## meta-chronos-bsp/conf/machine/tank.conf
```bitbake
#@TYPE: Machine
#@NAME: tank
#@DESCRIPTION: Machine configuration for the tank device

require conf/machine/include/arm/armv8a/tune-cortexa57.inc
require conf/machine/include/cartier.inc

# kernel default image type
KERNEL_IMAGETYPE = "Image.gz"

# kernel default config
KBUILD_DEFCONFIG = "defconfig"
```

## meta-chronos-distro/conf/distro/chronos.conf
```bitbake
require conf/distro/include/chronos.inc

DISTRO = "chronos"

# init
INIT_MANAGER = "none"
DISTRO_FEATURES:append = " initng"
DISTRO_FEATURES_BACKFILL_CONSIDERED += "sysvinit systemd"
VIRTUAL-RUNTIME_init_manager = "initng"
VIRTUAL-RUNTIME_initscripts = ""

# mdev
VIRTUAL-RUNTIME_dev_manager = "busybox-mdev"

# syslog
VIRTUAL-RUNTIME_syslog = "busybox-syslog"

# pam
DISTRO_FEATURES:append = " pam"
```

## meta-chronos-distro/conf/distro/include/chronos.inc
```bitbake
require conf/distro/poky.conf

DISTRO = "chronos"
DISTRO_NAME = "chronos"
DISTRO_VERSION = "1.0.0"

# use packaging format ipk
PACKAGE_CLASSES = "package_ipk"

# host tools needed to run testimage
HOSTTOOLS += "ip ping ps scp ssh"

# drop native language support
USE_NLS = "no"

# make log dir volatile
VOLATILE_LOG_DIR = "yes"

# disable the hash equivalence server
BB_SIGNATURE_HANDLER = "OEBasicHash"
BB_HASHSERVE = ""

# cache
INHERIT += "own-mirrors"
BB_GENERATE_MIRROR_TARBALLS = "1"
SOURCE_MIRROR_URL ?= "https://yocto.dorale.fr/source-mirror/"
SSTATE_MIRRORS ?= "file://.* https://yocto.dorale.fr/sstate-mirror/${MACHINE}/PATH;downloadfilename=PATH"

# users
USERADDEXTENSION = "useradd-staticids"
USERADD_UID_TABLES += "files/static-passwd"
USERADD_GID_TABLES += "files/static-group"

# icecream distributed compile support
INHERIT_DISTRO:append = " icecc"
ICECC_DISABLED ??= "1"
```

## meta-chronos-distro/conf/layer.conf
```bitbake
# We have a conf and classes directory, add to BBPATH
BBPATH .= ":${LAYERDIR}"

# We have recipes-* directories, add to BBFILES
# BBFILES += "${LAYERDIR}/recipes-*/*/*.bb \
#             ${LAYERDIR}/recipes-*/*/*.bbappend"

# BBFILE_COLLECTIONS += "meta-chronos-distro"
# BBFILE_PATTERN_meta-chronos-distro = "^${LAYERDIR}/"
# BBFILE_PRIORITY_meta-chronos-distro = "7"

LAYERSERIES_COMPAT_meta-chronos-distro = "scarthgap"
```

## meta-chronos/conf/layer.conf
```bitbake
# We have a conf and classes directory, add to BBPATH
BBPATH .= ":${LAYERDIR}"

# We have recipes-* directories, add to BBFILES
BBFILES += "${LAYERDIR}/recipes-*/*/*.bb \
            ${LAYERDIR}/recipes-*/*/*.bbappend"

BBFILE_COLLECTIONS += "meta-chronos"
BBFILE_PATTERN_meta-chronos = "^${LAYERDIR}/"
BBFILE_PRIORITY_meta-chronos = "7"

LAYERSERIES_COMPAT_meta-chronos = "scarthgap"
```
